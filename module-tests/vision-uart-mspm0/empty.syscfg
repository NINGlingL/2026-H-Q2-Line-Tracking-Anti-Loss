/**
 * @cliArgs --device "MSPM0G350X" --part "Default" --package "LQFP-64(PM)" --product "mspm0_sdk@2.02.00.05"
 * @versions {"tool":"1.21.1+3772"}
 */

/**
 * Import the modules used in this configuration.
 */
const I2C    = scripting.addModule("/ti/driverlib/I2C", {}, false);
const I2C1   = I2C.                                                                                                                                                    addInstance();
const SYSCTL = scripting.addModule("/ti/driverlib/SYSCTL");
const UART   = scripting.addModule("/ti/driverlib/UART", {}, false);
const UART1  = UART.addInstance();

/**
 * Write custom configuration values to the imported modules.
 */
I2C1.$name                           = "I2C_0";
I2C1.basicEnableController           = true;
I2C1.basicControllerStandardBusSpeed = "Fast";
I2C1.sdaPinConfig.$name              = "ti_driverlib_gpio_GPIOPinGeneric0";
I2C1.sclPinConfig.$name              = "ti_driverlib_gpio_GPIOPinGeneric1";

const Board = scripting.addModule("/ti/driverlib/Board", {}, false);

SYSCTL.forceDefaultClkConfig = true;

UART1.$name             = "UART_0";
UART1.uartClkDiv        = "8";
UART1.targetBaudRate    = 115200;
UART1.enabledInterrupts = ["RX"];
UART1.txPinConfig.$name = "ti_driverlib_gpio_GPIOPinGeneric2";
UART1.rxPinConfig.$name = "ti_driverlib_gpio_GPIOPinGeneric3";

/**
 * Pinmux solution for unlocked pins/peripherals. This ensures that minor changes to the automatic solver in a future
 * version of the tool will not impact the pinmux you originally saw.  These lines can be completely deleted in order to
 * re-solve from scratch.
 */
I2C1.peripheral.$suggestSolution           = "I2C0";
I2C1.peripheral.sdaPin.$suggestSolution    = "PA0";
I2C1.peripheral.sclPin.$suggestSolution    = "PA1";
Board.peripheral.$suggestSolution          = "DEBUGSS";
Board.peripheral.swclkPin.$suggestSolution = "PA20";
Board.peripheral.swdioPin.$suggestSolution = "PA19";
SYSCTL.peripheral.$suggestSolution         = "SYSCTL";
UART1.peripheral.$suggestSolution          = "UART0";
UART1.peripheral.rxPin.$suggestSolution    = "PA11";
UART1.peripheral.txPin.$suggestSolution    = "PA10";
