/**
 * SSD1306 128x64 OLED 驱动实现 (I2C)
 * 使用 SysConfig 生成的 I2C_0_INST
 */
#include "ssd1306.h"
#include "ti_msp_dl_config.h"
#include <string.h>

#define I2C_TO  150000UL
static uint8_t s_buf[SSD1306_PAGES][SSD1306_WIDTH];

/* ── I2C 底层 ── */
static void _cmd(uint8_t cmd)
{
    uint8_t tx[2] = {0x00, cmd};
    volatile uint32_t to = I2C_TO;
    while (!(DL_I2C_getControllerStatus(I2C_0_INST) & DL_I2C_CONTROLLER_STATUS_IDLE))
        if (--to == 0) return;
    DL_I2C_fillControllerTXFIFO(I2C_0_INST, tx, 2);
    DL_I2C_startControllerTransfer(I2C_0_INST, SSD1306_I2C_ADDR, DL_I2C_CONTROLLER_DIRECTION_TX, 2);
    to = I2C_TO; while (!(DL_I2C_getControllerStatus(I2C_0_INST) & DL_I2C_CONTROLLER_STATUS_BUSY_BUS)) if (--to==0) return;
    to = I2C_TO; while (!(DL_I2C_getControllerStatus(I2C_0_INST) & DL_I2C_CONTROLLER_STATUS_IDLE))     if (--to==0) return;
}

static void _data(uint8_t d)
{
    uint8_t tx[2] = {0x40, d};
    volatile uint32_t to = I2C_TO;
    while (!(DL_I2C_getControllerStatus(I2C_0_INST) & DL_I2C_CONTROLLER_STATUS_IDLE))
        if (--to == 0) return;
    DL_I2C_fillControllerTXFIFO(I2C_0_INST, tx, 2);
    DL_I2C_startControllerTransfer(I2C_0_INST, SSD1306_I2C_ADDR, DL_I2C_CONTROLLER_DIRECTION_TX, 2);
    to = I2C_TO; while (!(DL_I2C_getControllerStatus(I2C_0_INST) & DL_I2C_CONTROLLER_STATUS_BUSY_BUS)) if (--to==0) return;
    to = I2C_TO; while (!(DL_I2C_getControllerStatus(I2C_0_INST) & DL_I2C_CONTROLLER_STATUS_IDLE))     if (--to==0) return;
}

/* ── 写入多字节 (寄存器地址 + 数据) ── */
void SSD1306_WriteBytes(uint8_t *data, uint8_t len)
{
    volatile uint32_t to = I2C_TO;
    while (!(DL_I2C_getControllerStatus(I2C_0_INST) & DL_I2C_CONTROLLER_STATUS_IDLE))
        if (--to == 0) return;
    DL_I2C_fillControllerTXFIFO(I2C_0_INST, data, len);
    DL_I2C_startControllerTransfer(I2C_0_INST, SSD1306_I2C_ADDR, DL_I2C_CONTROLLER_DIRECTION_TX, len);
    to = I2C_TO; while (!(DL_I2C_getControllerStatus(I2C_0_INST) & DL_I2C_CONTROLLER_STATUS_BUSY_BUS)) if (--to==0) return;
    to = I2C_TO; while (!(DL_I2C_getControllerStatus(I2C_0_INST) & DL_I2C_CONTROLLER_STATUS_IDLE))     if (--to==0) return;
}

/* ── 初始化 ── */
void SSD1306_Init(void)
{
    uint8_t cmds[] = {0x00, 0xAE, 0x00,0xD5,0x00,0x80, 0x00,0xA8,0x00,0x3F,
        0x00,0xD3,0x00,0x00, 0x00,0x40, 0x00,0x8D,0x00,0x14,
        0x00,0x20,0x00,0x00, 0x00,0xA1, 0x00,0xC8,
        0x00,0xDA,0x00,0x12, 0x00,0x81,0x00,0xCF,
        0x00,0xD9,0x00,0xF1, 0x00,0xDB,0x00,0x40,
        0x00,0xA4, 0x00,0xA6, 0x00,0xAF};
    volatile uint32_t to;
    for (int i = 0; i < sizeof(cmds); i += 2) {
        to = I2C_TO;
        while (!(DL_I2C_getControllerStatus(I2C_0_INST) & DL_I2C_CONTROLLER_STATUS_IDLE))
            if (--to == 0) break;
        DL_I2C_fillControllerTXFIFO(I2C_0_INST, &cmds[i], 2);
        DL_I2C_startControllerTransfer(I2C_0_INST, SSD1306_I2C_ADDR, DL_I2C_CONTROLLER_DIRECTION_TX, 2);
        to = I2C_TO; while (!(DL_I2C_getControllerStatus(I2C_0_INST) & DL_I2C_CONTROLLER_STATUS_BUSY_BUS)) if (--to==0) break;
        to = I2C_TO; while (!(DL_I2C_getControllerStatus(I2C_0_INST) & DL_I2C_CONTROLLER_STATUS_IDLE))     if (--to==0) break;
    }
    SSD1306_Clear(); SSD1306_Update();
}

void SSD1306_Clear(void) { memset(s_buf, 0, sizeof(s_buf)); }

void SSD1306_Update(void)
{
    for (uint8_t p = 0; p < SSD1306_PAGES; p++) {
        _cmd(0xB0 + p); _cmd(0x00); _cmd(0x10);
        for (uint8_t c = 0; c < SSD1306_WIDTH; c++) _data(s_buf[p][c]);
    }
}

/* ── 5x7 字体 ── */
static void _char(uint8_t pg, uint8_t col, char ch)
{
    if (pg >= SSD1306_PAGES || ch < 0x20 || ch > 0x7E) return;
    static const uint8_t f[][5] = {
        {0x00,0x00,0x00,0x00,0x00},{0x00,0x00,0x5F,0x00,0x00},
        {0x00,0x07,0x00,0x07,0x00},{0x14,0x7F,0x14,0x7F,0x14},
        {0x24,0x2A,0x7F,0x2A,0x12},{0x23,0x13,0x08,0x64,0x62},
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        {0x08,0x04,0x08,0x10,0x08},
    };
    uint8_t idx = ch - 0x20;
    if (col + 5 < SSD1306_WIDTH)
        for (uint8_t i = 0; i < 5; i++) s_buf[pg][col + i] = f[idx][i];
}

void SSD1306_ShowString(uint8_t pg, uint8_t col, const char *s)
{
    while (*s && col + 6 <= SSD1306_WIDTH) { _char(pg, col, *s); col += 6; s++; }
}

void SSD1306_WriteFloat(uint8_t pg, uint8_t col, float v, uint8_t dec)
{
    char b[16]; int i = 0, neg = 0;
    if (v < 0) { neg = 1; v = -v; }
    int ip = (int)v; float fp = v - ip;
    if (ip == 0) b[i++] = '0';
    else { char t[8]; int ti = 0; while (ip > 0) { t[ti++] = '0'+(ip%10); ip/=10; } while (ti) b[i++] = t[--ti]; }
    if (neg) { for (int j = i; j > 0; j--) b[j] = b[j-1]; b[0] = '-'; i++; }
    if (dec) { b[i++] = '.'; for (uint8_t d = 0; d < dec; d++) fp *= 10.0f;
        int frac = (int)(fp + 0.5f); char t[8]; int ti = 0;
        for (uint8_t d = 0; d < dec; d++) { t[ti++] = '0'+(frac%10); frac/=10; }
        while (ti) b[i++] = t[--ti]; }
    b[i] = '\0';
    SSD1306_ShowString(pg, col, b);
}
