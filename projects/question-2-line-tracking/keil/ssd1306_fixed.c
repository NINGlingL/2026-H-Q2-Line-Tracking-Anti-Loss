#include "../ssd1306.h"
#include "../ti_msp_dl_config.h"
#include <stdbool.h>
#include <string.h>

#define OLED_TIMEOUT_LOOPS 150000UL

static uint8_t g_oled_buffer[SSD1306_PAGES][SSD1306_WIDTH];

static bool wait_idle(void)
{
    uint32_t timeout = OLED_TIMEOUT_LOOPS;
    while ((DL_I2C_getControllerStatus(OLED_INST) &
            DL_I2C_CONTROLLER_STATUS_IDLE) == 0U) {
        if (--timeout == 0U) return false;
    }
    return true;
}

static bool write_byte(uint8_t control, uint8_t value)
{
    uint8_t tx[2] = {control, value};

    if (!wait_idle()) return false;
    DL_I2C_flushControllerTXFIFO(OLED_INST);
    if (DL_I2C_fillControllerTXFIFO(OLED_INST, tx, 2U) != 2U) {
        return false;
    }
    DL_I2C_startControllerTransfer(
        OLED_INST, SSD1306_I2C_ADDR,
        DL_I2C_CONTROLLER_DIRECTION_TX, 2U);
    return wait_idle();
}

static void command(uint8_t value)
{
    (void)write_byte(0x00U, value);
}

static void data(uint8_t value)
{
    (void)write_byte(0x40U, value);
}

void SSD1306_Clear(void)
{
    memset(g_oled_buffer, 0, sizeof(g_oled_buffer));
}

void SSD1306_Update(void)
{
    for (uint8_t page = 0U; page < SSD1306_PAGES; ++page) {
        command((uint8_t)(0xB0U + page));
        command(0x00U);
        command(0x10U);
        for (uint16_t column = 0U; column < SSD1306_WIDTH; ++column) {
            data(g_oled_buffer[page][column]);
        }
    }
}

void SSD1306_Init(void)
{
    static const uint8_t sequence[] = {
        0xAE, 0xD5, 0x80, 0xA8, 0x3F, 0xD3, 0x00, 0x40,
        0x8D, 0x14, 0x20, 0x02, 0xA1, 0xC8, 0xDA, 0x12,
        0x81, 0x7F, 0xD9, 0xF1, 0xDB, 0x40, 0xA4, 0xA6,
        0x2E, 0xAF
    };

    delay_cycles(CPUCLK_FREQ / 50U);
    for (uint32_t i = 0U; i < sizeof(sequence); ++i) {
        command(sequence[i]);
    }
    SSD1306_Clear();
    SSD1306_Update();
}

static void draw_char(uint8_t page, uint8_t column, char character)
{
    static const uint8_t font[][5] = {
        {0x00,0x00,0x00,0x00,0x00},{0x00,0x00,0x5F,0x00,0x00},
        {0x00,0x07,0x00,0x07,0x00},{0x14,0x7F,0x14,0x7F,0x14},
        {0x24,0x2A,0x7F,0x2A,0x12},{0x23,0x13,0x08,0x64,0x62},
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        {0x08,0x04,0x08,0x10,0x08}
    };

    if (page >= SSD1306_PAGES || column > (SSD1306_WIDTH - 5U) ||
        character < 0x20 || character > 0x7E) {
        return;
    }
    for (uint8_t i = 0U; i < 5U; ++i) {
        g_oled_buffer[page][column + i] =
            font[(uint8_t)character - 0x20U][i];
    }
}

void SSD1306_ShowString(uint8_t page, uint8_t column, const char *text)
{
    if (text == 0) return;
    while (*text != '\0' && column <= (SSD1306_WIDTH - 6U)) {
        draw_char(page, column, *text++);
        g_oled_buffer[page][column + 5U] = 0U;
        column = (uint8_t)(column + 6U);
    }
}

void SSD1306_WriteFloat(uint8_t page, uint8_t column, float value,
                        uint8_t decimals)
{
    char text[20];
    int32_t integer;
    uint32_t fraction = 0U;
    uint32_t scale = 1U;
    uint8_t pos = 0U;

    if (decimals > 4U) decimals = 4U;
    if (value < 0.0f) {
        text[pos++] = '-';
        value = -value;
    }
    integer = (int32_t)value;
    if (integer == 0) {
        text[pos++] = '0';
    } else {
        char reverse[11];
        uint8_t count = 0U;
        while (integer > 0 && count < sizeof(reverse)) {
            reverse[count++] = (char)('0' + integer % 10);
            integer /= 10;
        }
        while (count > 0U) text[pos++] = reverse[--count];
    }
    if (decimals > 0U) {
        text[pos++] = '.';
        for (uint8_t i = 0U; i < decimals; ++i) scale *= 10U;
        fraction = (uint32_t)((value - (int32_t)value) * scale + 0.5f);
        for (uint8_t i = decimals; i > 0U; --i) {
            text[pos + i - 1U] = (char)('0' + fraction % 10U);
            fraction /= 10U;
        }
        pos = (uint8_t)(pos + decimals);
    }
    text[pos] = '\0';
    SSD1306_ShowString(page, column, text);
}
