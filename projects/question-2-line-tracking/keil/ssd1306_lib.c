/**
 * SSD1306 椹卞姩瀹炵幇 (I2C)
 * MSPM0G3507 + DriverLib
 */

#include "ssd1306_lib.h"

/* ========== 鏄剧ず缂撳啿鍖?(128x64 = 1024 瀛楄妭) ========== */
static uint8_t OLED_Buffer[SSD1306_WIDTH * SSD1306_HEIGHT / 8];

/* ========== 6x8 ASCII 瀛楀簱 (瀛楃 0x20 ~ 0x7E) ========== */
static const uint8_t Font6x8[][6] = {
    {0x00,0x00,0x00,0x00,0x00,0x00}, /* 绌烘牸 */
    {0x00,0x00,0x5F,0x00,0x00,0x00}, /* ! */
    {0x00,0x07,0x00,0x07,0x00,0x00}, /* " */
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    {0x08,0x04,0x08,0x10,0x08,0x00}, /* ~ */
};

/* ========== 搴曞眰 I2C 閫氫俊 ========== */

#define OLED_I2C_TIMEOUT 100000UL

static void I2C_WriteBytes(uint8_t *data, uint8_t len)
{
    volatile uint32_t timeout;

    DL_I2C_fillControllerTXFIFO(OLED_INST, data, len);
    timeout = OLED_I2C_TIMEOUT;
    while (!(DL_I2C_getControllerStatus(OLED_INST) &
             DL_I2C_CONTROLLER_STATUS_IDLE)) {
        if (--timeout == 0U) {
            DL_I2C_flushControllerTXFIFO(OLED_INST);
            return;
        }
    }
    DL_I2C_startControllerTransfer(OLED_INST, SSD1306_I2C_ADDR,
                                   DL_I2C_CONTROLLER_DIRECTION_TX, len);
    timeout = OLED_I2C_TIMEOUT;
    while (DL_I2C_getControllerStatus(OLED_INST) &
           DL_I2C_CONTROLLER_STATUS_BUSY_BUS) {
        if (--timeout == 0U) break;
    }
    timeout = OLED_I2C_TIMEOUT;
    while (!(DL_I2C_getControllerStatus(OLED_INST) &
             DL_I2C_CONTROLLER_STATUS_IDLE)) {
        if (--timeout == 0U) break;
    }
    DL_I2C_flushControllerTXFIFO(OLED_INST);
}

static void SSD1306_WriteCmd(uint8_t cmd)
{
    uint8_t buf[2] = {SSD1306_CMD_SINGLE, cmd};
    I2C_WriteBytes(buf, 2);
}

static void SSD1306_WriteData(uint8_t data)
{
    uint8_t buf[2] = {SSD1306_DATA_STREAM, data};
    I2C_WriteBytes(buf, 2);
}

/* ========== 鍩烘湰鎿嶄綔 ========== */

void SSD1306_Init(void)
{
    delay_cycles(CPUCLK_FREQ / 10U);
    /* 鍒濆鍖栧簭鍒?- 蹇呴』鎸夎繖涓『搴?*/
    SSD1306_WriteCmd(SSD1306_DISPLAY_OFF);

    SSD1306_WriteCmd(0x20);  /* 璁剧疆鍐呭瓨瀵诲潃妯″紡 */
    SSD1306_WriteCmd(0x02);  /* page addressing mode */

    SSD1306_WriteCmd(0xB0);  /* 璁剧疆椤佃捣濮嬪湴鍧€ */

    SSD1306_WriteCmd(0xC8);  /* COM 鎵弿鏂瑰悜: 浠?COM[N-1] 鍒?COM0 */

    SSD1306_WriteCmd(0x40);  /* 璁剧疆鏄剧ず璧峰琛?= 0 */

    SSD1306_WriteCmd(SSD1306_SET_CONTRAST);
    SSD1306_WriteCmd(0x7F);  /* 瀵规瘮搴?(0~255) */

    SSD1306_WriteCmd(0xA1);  /* 娈甸噸鏄犲皠: column 127 = SEG0 */

    SSD1306_WriteCmd(0xA6);  /* 姝ｅ父鏄剧ず (闈炲弽鑹? */

    SSD1306_WriteCmd(0xA8);  /* 璁剧疆澶氳矾澶嶇敤姣?*/
    SSD1306_WriteCmd(0x3F);  /* 1/64 duty */

    SSD1306_WriteCmd(0xA4);  /* 鏄剧ず璺熼殢 RAM 鍐呭 */

    SSD1306_WriteCmd(0xD3);  /* 璁剧疆鏄剧ず鍋忕Щ */
    SSD1306_WriteCmd(0x00);  /* 鏃犲亸绉?*/

    SSD1306_WriteCmd(0xD5);  /* 璁剧疆鏃堕挓鍒嗛/鎸崱鍣ㄩ鐜?*/
    SSD1306_WriteCmd(0xF0);

    SSD1306_WriteCmd(0xD9);  /* 璁剧疆棰勫厖鐢靛懆鏈?*/
    SSD1306_WriteCmd(0x22);

    SSD1306_WriteCmd(0xDA);  /* 璁剧疆 COM 寮曡剼閰嶇疆 */
    SSD1306_WriteCmd(0x12);

    SSD1306_WriteCmd(0xDB);  /* 璁剧疆 VCOMH 鐢靛帇 */
    SSD1306_WriteCmd(0x20);

    SSD1306_WriteCmd(0x8D);  /* 鐢佃嵎娉佃缃?*/
    SSD1306_WriteCmd(0x14);  /* 鍚敤鐢佃嵎娉?*/

    SSD1306_WriteCmd(SSD1306_DISPLAY_ON);

    SSD1306_Clear();
    SSD1306_Update();
}

void SSD1306_Clear(void)
{
    memset(OLED_Buffer, 0x00, sizeof(OLED_Buffer));
}

void SSD1306_Fill(uint8_t data)
{
    memset(OLED_Buffer, data, sizeof(OLED_Buffer));
}

void SSD1306_Update(void)
{
    for (uint8_t page = 0; page < SSD1306_PAGES; page++) {
        SSD1306_WriteCmd(0xB0 + page);
        SSD1306_WriteCmd(0x00);
        SSD1306_WriteCmd(0x10);
        for (uint8_t col = 0; col < SSD1306_WIDTH; col++) {
            SSD1306_WriteData(OLED_Buffer[page * SSD1306_WIDTH + col]);
        }
    }
}

void SSD1306_SetCursor(uint8_t page, uint8_t col)
{
    /* 浠呯敤浜?ShowChar 瀹氫綅锛屼笉鍦ㄥ簳灞傚彂 I2C */
    (void)page;
    (void)col;
}

/* ========== 鏄剧ず鍔熻兘 ========== */

void SSD1306_ShowChar(uint8_t page, uint8_t col, char ch)
{
    if (ch < 0x20 || ch > 0x7E) ch = ' ';  /* 闈炴硶瀛楃鏄剧ず绌烘牸 */
    if (page >= SSD1306_PAGES) return;
    if (col + 6 > SSD1306_WIDTH) return;

    uint8_t idx = ch - 0x20;
    for (uint8_t i = 0; i < 6; i++) {
        OLED_Buffer[page * SSD1306_WIDTH + col + i] = Font6x8[idx][i];
    }
}

void SSD1306_ShowString(uint8_t page, uint8_t col, const char *str)
{
    while (*str) {
        if (col + 6 > SSD1306_WIDTH) {
            col = 0;
            page++;
            if (page >= SSD1306_PAGES) return;
        }
        SSD1306_ShowChar(page, col, *str);
        col += 6;
        str++;
    }
}

void SSD1306_DrawPixel(uint8_t x, uint8_t y, uint8_t color)
{
    if (x >= SSD1306_WIDTH || y >= SSD1306_HEIGHT) return;

    uint8_t page = y / 8;
    uint8_t bit  = y % 8;
    uint16_t idx = page * SSD1306_WIDTH + x;

    if (color)
        OLED_Buffer[idx] |= (1 << bit);
    else
        OLED_Buffer[idx] &= ~(1 << bit);
}

void SSD1306_DrawHLine(uint8_t x, uint8_t y, uint8_t len, uint8_t color)
{
    for (uint8_t i = 0; i < len; i++)
        SSD1306_DrawPixel(x + i, y, color);
}

void SSD1306_ShowNum(uint8_t page, uint8_t col, int32_t num, uint8_t len)
{
    char buf[12];
    if (num < 0) {
        /* 绠€鍗曞鐞嗚礋鏁?*/
        SSD1306_ShowChar(page, col, '-');
        num = -num;
        col += 6;
        len--;
    }
    /* 杞崲涓哄瓧绗︿覆 */
    uint8_t i = 0;
    char tmp[12];
    do {
        tmp[i++] = '0' + (num % 10);
        num /= 10;
    } while (num > 0 && i < 11);

    /* 琛ラ綈鍓嶅闆?*/
    while (i < len && i < 11) tmp[i++] = '0';

    /* 鍙嶈浆杈撳嚭 */
    while (i > 0) {
        SSD1306_ShowChar(page, col, tmp[--i]);
        col += 6;
    }
}

