/**
 * SSD1306 驱动实现 (I2C)
 * MSPM0G3507 + DriverLib
 */

#include "ssd1306.h"

/* ========== 显示缓冲区 (128x64 = 1024 字节) ========== */
static uint8_t OLED_Buffer[SSD1306_WIDTH * SSD1306_HEIGHT / 8];

/* ========== 6x8 ASCII 字库 (字符 0x20 ~ 0x7E) ========== */
static const uint8_t Font6x8[][6] = {
    {0x00,0x00,0x00,0x00,0x00,0x00}, /* 空格 */
    {0x00,0x00,0x5F,0x00,0x00,0x00}, /* ! */
    {0x00,0x07,0x00,0x07,0x00,0x00}, /* " */
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    {0x08,0x04,0x08,0x10,0x08,0x00}, /* ~ */
};

/* ========== 底层 I2C 通信 ========== */

static void I2C_WriteBytes(uint8_t *data, uint8_t len)
{
    DL_I2C_fillControllerTXFIFO(I2C_1_INST, data, len);
    while (!(DL_I2C_getControllerStatus(I2C_1_INST) & DL_I2C_CONTROLLER_STATUS_IDLE));
    DL_I2C_startControllerTransfer(I2C_1_INST, SSD1306_I2C_ADDR,
                                   DL_I2C_CONTROLLER_DIRECTION_TX, len);
    while (DL_I2C_getControllerStatus(I2C_1_INST) & DL_I2C_CONTROLLER_STATUS_BUSY_BUS);
    while (!(DL_I2C_getControllerStatus(I2C_1_INST) & DL_I2C_CONTROLLER_STATUS_IDLE));
    DL_I2C_flushControllerTXFIFO(I2C_1_INST);
}

static void SSD1306_WriteCmd(uint8_t cmd)
{
    uint8_t buf[2] = {SSD1306_CMD_SINGLE, cmd};
    I2C_WriteBytes(buf, 2);
}

static void SSD1306_WriteData(uint8_t data)
{
    uint8_t buf[2] = {SSD1306_DATA_STREAM, data};
    I2C_WriteBytes(buf, 2);
}

/* ========== 基本操作 ========== */

void SSD1306_Init(void)
{
    /* 初始化序列 - 必须按这个顺序 */
    SSD1306_WriteCmd(SSD1306_DISPLAY_OFF);

    SSD1306_WriteCmd(0x20);  /* 设置内存寻址模式 */
    SSD1306_WriteCmd(0x00);  /* 水平寻址模式 */

    SSD1306_WriteCmd(0xB0);  /* 设置页起始地址 */

    SSD1306_WriteCmd(0xC8);  /* COM 扫描方向: 从 COM[N-1] 到 COM0 */

    SSD1306_WriteCmd(0x40);  /* 设置显示起始行 = 0 */

    SSD1306_WriteCmd(SSD1306_SET_CONTRAST);
    SSD1306_WriteCmd(0x7F);  /* 对比度 (0~255) */

    SSD1306_WriteCmd(0xA1);  /* 段重映射: column 127 = SEG0 */

    SSD1306_WriteCmd(0xA6);  /* 正常显示 (非反色) */

    SSD1306_WriteCmd(0xA8);  /* 设置多路复用比 */
    SSD1306_WriteCmd(0x3F);  /* 1/64 duty */

    SSD1306_WriteCmd(0xA4);  /* 显示跟随 RAM 内容 */

    SSD1306_WriteCmd(0xD3);  /* 设置显示偏移 */
    SSD1306_WriteCmd(0x00);  /* 无偏移 */

    SSD1306_WriteCmd(0xD5);  /* 设置时钟分频/振荡器频率 */
    SSD1306_WriteCmd(0xF0);

    SSD1306_WriteCmd(0xD9);  /* 设置预充电周期 */
    SSD1306_WriteCmd(0x22);

    SSD1306_WriteCmd(0xDA);  /* 设置 COM 引脚配置 */
    SSD1306_WriteCmd(0x12);

    SSD1306_WriteCmd(0xDB);  /* 设置 VCOMH 电压 */
    SSD1306_WriteCmd(0x20);

    SSD1306_WriteCmd(0x8D);  /* 电荷泵设置 */
    SSD1306_WriteCmd(0x14);  /* 启用电荷泵 */

    SSD1306_WriteCmd(SSD1306_DISPLAY_ON);

    SSD1306_Clear();
    SSD1306_Update();
}

void SSD1306_Clear(void)
{
    memset(OLED_Buffer, 0x00, sizeof(OLED_Buffer));
}

void SSD1306_Fill(uint8_t data)
{
    memset(OLED_Buffer, data, sizeof(OLED_Buffer));
}

void SSD1306_Update(void)
{
    for (uint8_t page = 0; page < SSD1306_PAGES; page++) {
        SSD1306_WriteCmd(0xB0 + page);  /* 设置页 */
        SSD1306_WriteCmd(0x00);          /* 设置列低四位 */
        SSD1306_WriteCmd(0x10);          /* 设置列高四位 */

        /* 批量发送一页数据 */
        for (uint8_t col = 0; col < SSD1306_WIDTH; col++) {
            SSD1306_WriteData(OLED_Buffer[page * SSD1306_WIDTH + col]);
        }
    }
}

void SSD1306_SetCursor(uint8_t page, uint8_t col)
{
    /* 仅用于 ShowChar 定位，不在底层发 I2C */
    (void)page;
    (void)col;
}

/* ========== 显示功能 ========== */

void SSD1306_ShowChar(uint8_t page, uint8_t col, char ch)
{
    if (ch < 0x20 || ch > 0x7E) ch = ' ';  /* 非法字符显示空格 */
    if (page >= SSD1306_PAGES) return;
    if (col + 6 > SSD1306_WIDTH) return;

    uint8_t idx = ch - 0x20;
    for (uint8_t i = 0; i < 6; i++) {
        OLED_Buffer[page * SSD1306_WIDTH + col + i] = Font6x8[idx][i];
    }
}

void SSD1306_ShowString(uint8_t page, uint8_t col, const char *str)
{
    while (*str) {
        if (col + 6 > SSD1306_WIDTH) {
            col = 0;
            page++;
            if (page >= SSD1306_PAGES) return;
        }
        SSD1306_ShowChar(page, col, *str);
        col += 6;
        str++;
    }
}

void SSD1306_DrawPixel(uint8_t x, uint8_t y, uint8_t color)
{
    if (x >= SSD1306_WIDTH || y >= SSD1306_HEIGHT) return;

    uint8_t page = y / 8;
    uint8_t bit  = y % 8;
    uint16_t idx = page * SSD1306_WIDTH + x;

    if (color)
        OLED_Buffer[idx] |= (1 << bit);
    else
        OLED_Buffer[idx] &= ~(1 << bit);
}

void SSD1306_DrawHLine(uint8_t x, uint8_t y, uint8_t len, uint8_t color)
{
    for (uint8_t i = 0; i < len; i++)
        SSD1306_DrawPixel(x + i, y, color);
}

void SSD1306_ShowNum(uint8_t page, uint8_t col, int32_t num, uint8_t len)
{
    char buf[12];
    if (num < 0) {
        /* 简单处理负数 */
        SSD1306_ShowChar(page, col, '-');
        num = -num;
        col += 6;
        len--;
    }
    /* 转换为字符串 */
    uint8_t i = 0;
    char tmp[12];
    do {
        tmp[i++] = '0' + (num % 10);
        num /= 10;
    } while (num > 0 && i < 11);

    /* 补齐前导零 */
    while (i < len && i < 11) tmp[i++] = '0';

    /* 反转输出 */
    while (i > 0) {
        SSD1306_ShowChar(page, col, tmp[--i]);
        col += 6;
    }
}
